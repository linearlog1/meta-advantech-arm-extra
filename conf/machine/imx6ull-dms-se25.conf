## conf/machine/imx6ull-dms-se25.conf
```bitbake
#@TYPE: Machine
#@NAME: Advantech DMS-SE25
#@SOC: i.MX6ULL
#@DESCRIPTION: Machine configuration for Advantech DMS-SE25 board

include conf/machine/include/imx-base.inc
include conf/machine/include/tune-cortexa7.inc

MACHINE_FIRMWARE_append = " firmware-imx-epdc"

MACHINEOVERRIDES =. "mx6:mx6ul:mx6ull:"

KERNEL_DEVICETREE = "imx6ull-dmsse25.dtb"

UBOOT_CONFIG ??= "sd"
UBOOT_CONFIG[sd] = "dms-se25_defconfig,sdcard"

IMAGE_INSTALL_append = " net-snmp net-snmp-server net-snmp-libs net-snmp-mibs ntp init-ifupdown ap6236-firmware-nvram hostapd dnsmasq apache2 bash iperf ethtool "

# Advantech packages
IMAGE_INSTALL_append = " DeviceInfo uartloopback parted brcm-patchram-plus "

# telnet and telnetd
IMAGE_INSTALL_append = " xinetd netkit-telnet"

VIRTUAL-RUNTIME_snmp-manager = "net-snmp-server"

BOOT_SPACE = "32768"
IMAGE_ROOTFS_EXTRA_SPACE = "131072"
```
